## kernel/kernel_device_modules-6.6/drivers/misc/mediatek/audio_ipi/Kconfig
```kconfig
config MTK_AUDIO_IPI
	tristate "Enable MTK audio ipi support"
	depends on MTK_AUDIODSP_SUPPORT || MTK_SCP_AUDIO
	default m
	help
	  This option enables MTK audio ipi modules to communicate
	  with subsystem.
	  This option depends on MediaTek in-house audio DSP support
	  or audio feature support on MediaTek in-house DSP.

config ADSP_SCENE_LEGACY
	bool "Use MT6893 legacy audio HAL and DSP scene numbers"
	depends on MTK_ADSP_V1 && !SND_SOC_MTK_AUTO_AUDIO_DSP
	default n
	help
	  Preserve the scene numbers and 33-entry task-info ioctl ABI used by
	  the original MT6893 HAL and DSP firmware. Newer DSP tasks remain
	  unavailable with this option. Enable only with that legacy firmware.

config DEVICE_MODULES_VHOST_ADSP
	tristate "Host kernel accelerator for virtio blk (EXPERIMENTAL)"
	depends on BLOCK
	select VHOST
	help
	  This kernel module can be loaded in host kernel to accelerate
	  guest block with virtio_adsp. Not to be confused with virtio_adsp
	  module itself which needs to be loaded in guest kernel.

	  To compile this driver as a module, choose M here: the module will
	  be called vhost_adsp.

config ADSP_VOIP_LEGACY
	bool "Enable voip DL and UL support on same coreB"
	depends on MTK_AUDIODSP_SUPPORT || CONFIG_MTK_AUDIO_IPI
	default n
	help
	  Enable support for VoIP Downlink (DL) and Uplink (UL) on the same core for legacy chips with dual-core ADSP.
	  This option is necessary for older architectures where VoIP DL and UL cannot be handled on separate cores.
	  Newer architectures support VoIP DL and UL on separate cores, but this feature is not available on older chips.
	  If you are unsure, select "N".
```

## kernel/kernel_device_modules-6.6/drivers/misc/mediatek/mmqos-pmqos/Kconfig
```kconfig
# SPDX-License-Identifier: GPL-2.0

config MTK_MMQOS_PMQOS_LEGACY
	tristate "MM QoS / SMI BWC front end for the 4.19 mmdvfs_pmqos board contract"
	depends on OF
	help
	  The op6893 board DT is the 4.19 one: it describes multimedia QoS
	  with a single "mediatek,mmdvfs_pmqos" node carrying the per-larb
	  port ratios, the max-OSTD larbs, the VCORE OPP steps and the
	  clock-mux frequency steps for every multimedia class.

	  The 6.6 multimedia QoS stack (mmqos-common + mmqos-mt6893) instead
	  expects a "mediatek,mt6893-mmqos" node with larbs-supply and
	  commons-supply phandles plus per-consumer "interconnects"
	  properties.  None of that exists in the board DT, so on this port
	  nothing consumes the QoS contract at all.

	  This driver consumes the contract the board DT actually provides.
	  Stage 1 parses and validates it and exports it through debugfs
	  without touching any hardware.

	  If unsure, say N.
```
